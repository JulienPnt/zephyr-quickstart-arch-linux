## CMakeLists.txt
```
# Minimum CMake version
cmake_minimum_required(VERSION 3.22.0)

# Locate the Zephyr RTOS source
find_package(Zephyr REQUIRED HINTS $ENV{ZEPHYR_BASE})

# Name the project
project(blink)

# Locate the source code for the application
target_sources(app PRIVATE src/main.c)
```

## prj.conf
```kconfig
CONFIG_GPIO=y
CONFIG_LOG=y
CONFIG_LOG_MODE_IMMEDIATE=y
CONFIG_MAIN_STACK_SIZE=1024
```

## boards/esp32c3_devkitm.overlay
```dts
/ {
    aliases {
        my-led = &led0;
    };

    leds {
        compatible = "gpio-leds";
        led0: user_led {
            gpios = <&gpio0 2 GPIO_ACTIVE_HIGH>;
        };
    };
};
```

## boards/nucleo_f446re.overlay
```dts
/ {
    aliases {
        my-led = &green_led_2;
    };
};
```

## src/main.c
```c
#include <zephyr/drivers/gpio.h>
#include <zephyr/kernel.h>

// Settings
static const int32_t sleep_time_ms = 500;
static const struct gpio_dt_spec led =
    GPIO_DT_SPEC_GET(DT_ALIAS(my_led), gpios);

int main(void) {
  int ret;
  int state = 0;

  // Make sure that the GPIO was initialized
  if (!gpio_is_ready_dt(&led)) {
    return 0;
  }

  // Set the GPIO as output
  ret = gpio_pin_configure_dt(&led, GPIO_OUTPUT);
  if (ret < 0) {
    return 0;
  }

  // Do forever
  while (1) {

    // Change the state of the pin and print
    state = !state;
    printk("LED state: %d\r\n", state);

    // Set pin state
    ret = gpio_pin_set_dt(&led, state);
    if (ret < 0) {
      return 0;
    }

    // Sleep
    k_msleep(sleep_time_ms);
  }

  return 0;
}
```
